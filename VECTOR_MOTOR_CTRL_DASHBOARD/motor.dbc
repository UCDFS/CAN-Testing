VERSION ""

NS_ :

BS_:

BU_:
VAL_TABLE_ MotorEnabled 1 "ENABLED" 0 "DISABLED" ;

BO_ 768 CanoeSimStatus: 1 Vector__XXX
 SG_ MotorEnabledStatus : 7|8@0+ (1,0) [0|0] "" Vector__XXX

BO_ 513 MotorReceiveID: 3 Vector__XXX
 SG_ ENABLED m81 : 8|16@1+ (1,0) [0|0] "" Vector__XXX
 SG_ TorqueValue m144 : 8|16@1+ (0.0030518,0) [0|0] "%" Vector__XXX
 SG_ RegisterID M : 7|8@0+ (1,0) [0|0] "" Vector__XXX

BA_DEF_  "BusType" STRING ;
BA_DEF_DEF_  "BusType" "";
BA_ "BusType" "CAN";
VAL_ 768 MotorEnabledStatus 1 "ENABLED" 0 "DISABLED" ;
